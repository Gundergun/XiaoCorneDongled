## boards/shields/corne_xiao_v1/Kconfig.defconfig
```kconfig
if SHIELD_CORNE_XIAO_V1_DONGLE

config ZMK_KEYBOARD_NAME
    default "Corne Dongle"

config ZMK_SPLIT_ROLE_CENTRAL
    default y

config ZMK_SPLIT_BLE_CENTRAL_PERIPHERALS
    default 2

config BT_MAX_CONN
    default 7

config BT_MAX_PAIRED
    default 7

endif

if SHIELD_CORNE_XIAO_V1_DONGLE || SHIELD_CORNE_XIAO_V1_LEFT || SHIELD_CORNE_XIAO_V1_RIGHT  

config ZMK_SPLIT
    default y

endif
```

## boards/shields/corne_xiao_v1/Kconfig.shield
```kconfig
config SHIELD_CORNE_XIAO_V1_DONGLE
    def_bool $(shields_list_contains,corne_xiao_v1_dongle)

config SHIELD_CORNE_XIAO_V1_LEFT
    def_bool $(shields_list_contains,corne_xiao_v1_left)

config SHIELD_CORNE_XIAO_V1_RIGHT
    def_bool $(shields_list_contains,corne_xiao_v1_right)
```
